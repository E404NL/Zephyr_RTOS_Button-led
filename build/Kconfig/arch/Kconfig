## build/Kconfig/arch/Kconfig
```kconfig
# Load arch Kconfig descriptions.
osource "/home/nerium/zephyrproject/zephyr/arch/x86/Kconfig"
osource "/home/nerium/zephyrproject/zephyr/arch/xtensa/Kconfig"
osource "/home/nerium/zephyrproject/zephyr/arch/sparc/Kconfig"
osource "/home/nerium/zephyrproject/zephyr/arch/riscv/Kconfig"
osource "/home/nerium/zephyrproject/zephyr/arch/posix/Kconfig"
osource "/home/nerium/zephyrproject/zephyr/arch/nios2/Kconfig"
osource "/home/nerium/zephyrproject/zephyr/arch/mips/Kconfig"
osource "/home/nerium/zephyrproject/zephyr/arch/arm64/Kconfig"
osource "/home/nerium/zephyrproject/zephyr/arch/arm/Kconfig"
osource "/home/nerium/zephyrproject/zephyr/arch/arc/Kconfig"
```

## build/Kconfig/soc/Kconfig
```kconfig
# Load Zephyr SoC Kconfig descriptions.
osource "/home/nerium/zephyrproject/zephyr/soc/xlnx/zynqmp/Kconfig"
osource "/home/nerium/zephyrproject/zephyr/soc/xlnx/zynq7000/Kconfig"
osource "/home/nerium/zephyrproject/zephyr/soc/xen/Kconfig"
osource "/home/nerium/zephyrproject/zephyr/soc/ti/simplelink/Kconfig"
osource "/home/nerium/zephyrproject/zephyr/soc/ti/lm3s6965/Kconfig"
osource "/home/nerium/zephyrproject/zephyr/soc/ti/k3/Kconfig"
osource "/home/nerium/zephyrproject/zephyr/soc/telink/tlsr/Kconfig"
osource "/home/nerium/zephyrproject/zephyr/soc/synopsys/qemu_arc/Kconfig"
osource "/home/nerium/zephyrproject/zephyr/soc/synopsys/nsim/Kconfig"
osource "/home/nerium/zephyrproject/zephyr/soc/synopsys/hsdk4xd/Kconfig"
osource "/home/nerium/zephyrproject/zephyr/soc/synopsys/hsdk/Kconfig"
osource "/home/nerium/zephyrproject/zephyr/soc/synopsys/emsk/Kconfig"
osource "/home/nerium/zephyrproject/zephyr/soc/synopsys/emsdp/Kconfig"
osource "/home/nerium/zephyrproject/zephyr/soc/synopsys/arc_iot/Kconfig"
osource "/home/nerium/zephyrproject/zephyr/soc/starfive/jh71xx/Kconfig"
osource "/home/nerium/zephyrproject/zephyr/soc/st/stm32/Kconfig"
osource "/home/nerium/zephyrproject/zephyr/soc/silabs/Kconfig"
osource "/home/nerium/zephyrproject/zephyr/soc/sifive/sifive_freedom/Kconfig"
osource "/home/nerium/zephyrproject/zephyr/soc/rockchip/Kconfig"
osource "/home/nerium/zephyrproject/zephyr/soc/riscv/qemu_virt_riscv/Kconfig"
osource "/home/nerium/zephyrproject/zephyr/soc/renode/riscv_virtual/Kconfig"
osource "/home/nerium/zephyrproject/zephyr/soc/renesas/smartbond/Kconfig"
osource "/home/nerium/zephyrproject/zephyr/soc/renesas/rzt2m/Kconfig"
osource "/home/nerium/zephyrproject/zephyr/soc/renesas/rcar/Kconfig"
osource "/home/nerium/zephyrproject/zephyr/soc/renesas/ra/Kconfig"
osource "/home/nerium/zephyrproject/zephyr/soc/raspberrypi/Kconfig"
osource "/home/nerium/zephyrproject/zephyr/soc/quicklogic/eos_s3/Kconfig"
osource "/home/nerium/zephyrproject/zephyr/soc/qemu_malta/Kconfig"
osource "/home/nerium/zephyrproject/zephyr/soc/openisa/rv32m1/Kconfig"
osource "/home/nerium/zephyrproject/zephyr/soc/nxp/s32/Kconfig"
osource "/home/nerium/zephyrproject/zephyr/soc/nxp/rw/Kconfig"
osource "/home/nerium/zephyrproject/zephyr/soc/nxp/mcx/Kconfig"
osource "/home/nerium/zephyrproject/zephyr/soc/nxp/lpc/Kconfig"
osource "/home/nerium/zephyrproject/zephyr/soc/nxp/layerscape/Kconfig"
osource "/home/nerium/zephyrproject/zephyr/soc/nxp/kinetis/Kconfig"
osource "/home/nerium/zephyrproject/zephyr/soc/nxp/imxrt/Kconfig"
osource "/home/nerium/zephyrproject/zephyr/soc/nxp/imx/Kconfig"
osource "/home/nerium/zephyrproject/zephyr/soc/nuvoton/numicro/Kconfig"
osource "/home/nerium/zephyrproject/zephyr/soc/nuvoton/numaker/Kconfig"
osource "/home/nerium/zephyrproject/zephyr/soc/nuvoton/npcx/Kconfig"
osource "/home/nerium/zephyrproject/zephyr/soc/nordic/Kconfig"
osource "/home/nerium/zephyrproject/zephyr/soc/neorv32/Kconfig"
osource "/home/nerium/zephyrproject/zephyr/soc/native/inf_clock/Kconfig"
osource "/home/nerium/zephyrproject/zephyr/soc/microchip/miv/Kconfig"
osource "/home/nerium/zephyrproject/zephyr/soc/microchip/mec/Kconfig"
osource "/home/nerium/zephyrproject/zephyr/soc/lowrisc/opentitan/Kconfig"
osource "/home/nerium/zephyrproject/zephyr/soc/litex/litex_vexriscv/Kconfig"
osource "/home/nerium/zephyrproject/zephyr/soc/ite/ec/Kconfig"
osource "/home/nerium/zephyrproject/zephyr/soc/intel/raptor_lake/Kconfig"
osource "/home/nerium/zephyrproject/zephyr/soc/intel/lakemont/Kconfig"
osource "/home/nerium/zephyrproject/zephyr/soc/intel/intel_socfpga_std/Kconfig"
osource "/home/nerium/zephyrproject/zephyr/soc/intel/intel_socfpga/Kconfig"
osource "/home/nerium/zephyrproject/zephyr/soc/intel/intel_niosv/Kconfig"
osource "/home/nerium/zephyrproject/zephyr/soc/intel/intel_ish/Kconfig"
osource "/home/nerium/zephyrproject/zephyr/soc/intel/intel_adsp/Kconfig"
osource "/home/nerium/zephyrproject/zephyr/soc/intel/elkhart_lake/Kconfig"
osource "/home/nerium/zephyrproject/zephyr/soc/intel/atom/Kconfig"
osource "/home/nerium/zephyrproject/zephyr/soc/intel/apollo_lake/Kconfig"
osource "/home/nerium/zephyrproject/zephyr/soc/intel/alder_lake/Kconfig"
osource "/home/nerium/zephyrproject/zephyr/soc/infineon/xmc/Kconfig"
osource "/home/nerium/zephyrproject/zephyr/soc/gd/gd32/Kconfig"
osource "/home/nerium/zephyrproject/zephyr/soc/gaisler/leon3/Kconfig"
osource "/home/nerium/zephyrproject/zephyr/soc/gaisler/gr716a/Kconfig"
osource "/home/nerium/zephyrproject/zephyr/soc/espressif/Kconfig"
osource "/home/nerium/zephyrproject/zephyr/soc/efinix/sapphire/Kconfig"
osource "/home/nerium/zephyrproject/zephyr/soc/cypress/Kconfig"
osource "/home/nerium/zephyrproject/zephyr/soc/cdns/xtensa_sample_controller/Kconfig"
osource "/home/nerium/zephyrproject/zephyr/soc/cdns/dc233c/Kconfig"
osource "/home/nerium/zephyrproject/zephyr/soc/brcm/bcmvk/Kconfig"
osource "/home/nerium/zephyrproject/zephyr/soc/brcm/bcm2711/Kconfig"
osource "/home/nerium/zephyrproject/zephyr/soc/atmel/sam0/Kconfig"
osource "/home/nerium/zephyrproject/zephyr/soc/atmel/sam/Kconfig"
osource "/home/nerium/zephyrproject/zephyr/soc/aspeed/Kconfig"
osource "/home/nerium/zephyrproject/zephyr/soc/arm/Kconfig"
osource "/home/nerium/zephyrproject/zephyr/soc/arm/beetle/Kconfig"
osource "/home/nerium/zephyrproject/zephyr/soc/andestech/Kconfig"
osource "/home/nerium/zephyrproject/zephyr/soc/ambiq/Kconfig"
osource "/home/nerium/zephyrproject/zephyr/soc/altr/zephyr_nios2f/Kconfig"
osource "/home/nerium/zephyrproject/zephyr/soc/altr/qemu_nios2/Kconfig"
```
